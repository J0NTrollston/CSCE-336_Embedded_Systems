/*--------------------------------------------------------------------
Name:   Brandon Ramos
Date:   9/28/2020
Course: CSCE 236 Embedded Systems (Fall 2020) 
HW/Lab: Homework 4

Doc:  Professor and TA help

Academic Integrity Statement: I certify that, while others may have 
assisted me in brain storming, debugging and validating this program, 
the program itself is my own work. I understand that submitting code 
which is the work of other individuals is a violation of the honor   
code.  I also understand that if I knowingly give my original work to 
another individual is also a violation of the honor code.
--------------------------------------------------------------------*/
#include <Arduino.h>

//constants and variables for Messages
int encodedMessage1[95] = {0xef, 0xc3, 0xc2, 0xcb, 0xde, 0xcd, 0xd8, 0xd9, 0xc0, 0xcd, 0xd8, 0xc5, 0xc3,
0xc2, 0xdf, 0x8d, 0x8c, 0x8c, 0xf5, 0xc3, 0xd9, 0x8c, 0xc8, 0xc9, 0xcf, 0xde,
0xd5, 0xdc, 0xd8, 0xc9, 0xc8, 0x8c, 0xd8, 0xc4, 0xc9, 0x8c, 0xef, 0xff, 0xef,
0xe9, 0x9e, 0x9f, 0x9a, 0x8c, 0xc4, 0xc5, 0xc8, 0xc8, 0xc9, 0xc2, 0x8c, 0xc1,
0xc9, 0xdf, 0xdf, 0xcd, 0xcB, 0xc9, 0x8c, 0xcd, 0xc2, 0xc8, 0x8c, 0xcd, 0xCf,
0xc4, 0xc5, 0xc9, 0xda, 0xc9, 0xc8, 0x8c, 0xde, 0xc9, 0xdd, 0xd9, 0xc5, 0xde,
0xc9, 0xc8, 0x8c, 0xca, 0xd9, 0xc2, 0xcf, 0xd8, 0xc5, 0xc3, 0xc2, 0xcd, 0xc0,
0xc5, 0xd8, 0xd5, 0x8f};
char decodedMessage1[95];
int encodedMessage2[] = {0xf8, 0xb7, 0x46, 0x8c, 0xb2, 0x46, 0xdf, 0xac, 0x42, 0xcb, 0xba, 0x03, 0xc7,
0xba, 0x5a, 0x8c, 0xb3, 0x46, 0xc2, 0xb8, 0x57, 0xc4, 0xff, 0x4a, 0xdf, 0xff,
0x12, 0x9a, 0xff, 0x41, 0xc5, 0xab, 0x50, 0x82, 0xff, 0x03, 0xe5, 0xab, 0x03,
0xc3, 0xb1, 0x4f, 0xd5, 0xff, 0x40, 0xc3, 0xb1, 0x57, 0xcd, 0xb6, 0x4d, 0xdf,
0xff, 0x4f, 0xc9, 0xab, 0x57, 0xc9, 0xad, 0x50, 0x80, 0xff, 0x53, 0xc9, 0xad,
0x4a, 0xc3, 0xbb, 0x50, 0x80, 0xff, 0x42, 0xc2, 0xbb, 0x03, 0xdf, 0xaf, 0x42,
0xcf, 0xba, 0x50};
int encodedMessage3[] = {0x35, 0xdf, 0x00, 0xca, 0x5d, 0x9e, 0x3d, 0xdb, 0x12, 0xca, 0x5d, 0x9e, 0x32,
0xc8, 0x16, 0xcc, 0x12, 0xd9, 0x16, 0x90, 0x53, 0xf8, 0x01, 0xd7, 0x16, 0xd0,
0x17, 0xd2, 0x0a, 0x90, 0x53, 0xf9, 0x1c, 0xd1, 0x17, 0x90, 0x53, 0xf9, 0x1c,
0xd1, 0x17, 0x9e};

void decodemessage1(){
  int key1 = 0xac; //Key for message 1
  //decode message and store into an array
  for(int index = 0; index < 95; index++){
    char c = key1 xor encodedMessage1[index];
    decodedMessage1[index] = c;
  }
  //print decoded message
  for(int index = 0; index < 95; index++){
    Serial.print(decodedMessage1[index]);
    delay(30);
  }
}

//lengthOfKey will be the number of bytes in the key
void decodemessage2(int lengthOfKey){
  char key2[] = "acdf23";
  int byte[] = {0xac,0xdf,0x23};
  uint8_t inc = 0;
  char c;
  for(int index = 0; index < 81; index++){
    if(inc == lengthOfKey){
      inc = 0;
    }
    c = byte[inc] xor encodedMessage2[index];
    inc++;
    Serial.print(c);
    delay(30);
  }
}

//know the key is max 0xffff so rotates from top byte to low and repeat
// The message key length is 16 bits.It only contains letters, periods, and spaces
void decodemessage3(){
  int higherByte = 0;
  int lowerByte = 0;
  //j is lower and i is higher
  for(int i = 103 ; i < 255 ; i++){
    for(int j = 127 ; j < 193; j++){
      for(int index = 0; index < 42; index+=2){
        char c = i xor encodedMessage3[index];
        if(c>=0x41 && c<=0x5a || c>=0x61 && c<=0x7a || c==0x2e || c==0x20){
          char highC = c;
          c = j xor encodedMessage3[index+1];
          if(c>=0x41 && c<=0x5a || c>=0x61 && c<=0x7a || c==0x2e || c==0x20){
            Serial.print(highC);
            Serial.print(c);
          }
        }
      } 
      Serial.print("       KEY: ");
      Serial.print(i,HEX);
      Serial.print(" ");
      Serial.print(j,HEX); 
      Serial.println();
    }
  }
}

//stopped at hex KEY: 0x68A7

void setup() {
  // put your setup code here, to run once:
  Serial.begin(9600);
  Serial.println("Starting...");

  // decodemessage1();
  // decodemessage2(3);
  decodemessage3();
}

void loop() {
  // put your main code here, to run repeatedly:

} 